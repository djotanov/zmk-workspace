## config/boards/shields/aurora_cygnus/Kconfig.shield
```kconfig
config SHIELD_AURORA_CYGNUS_LEFT
    def_bool $(shields_list_contains,aurora_cygnus_left)

config SHIELD_AURORA_CYGNUS_RIGHT
    def_bool $(shields_list_contains,aurora_cygnus_right)
```

## config/boards/shields/aurora_sweep/Kconfig.shield
```kconfig
# Copyright (c) 2022 The ZMK Contributors
# SPDX-License-Identifier: MIT

config SHIELD_AURORA_SWEEP_LEFT
    def_bool $(shields_list_contains,aurora_sweep_left)

config SHIELD_AURORA_SWEEP_RIGHT
    def_bool $(shields_list_contains,aurora_sweep_right)

config SHIELD_AURORA_SWEEP_DONGLE
    def_bool $(shields_list_contains,aurora_sweep_dongle)
```
